## 02_wifi_mqtt_led/main/Kconfig.projbuild
```kconfig
menu "ESP32 Wi-Fi & MQTT Configuration"

    config ESP_WIFI_SSID
        string "Wi-Fi SSID"
        default "YOUR_WIFI_SSID"
        help
            SSID (network name) of your Wi-Fi router.

    config ESP_WIFI_PASSWORD
        string "Wi-Fi Password"
        default "YOUR_WIFI_PASSWORD"
        help
            Password for your Wi-Fi network.

    config ESP_WIFI_MAXIMUM_RETRY
        int "Maximum Wi-Fi Connection Retries"
        default 10
        help
            Set the Maximum retry count for Wi-Fi connection attempts.

    config MQTT_BROKER_URI
        string "MQTT Broker URI"
        default "mqtt://broker.hivemq.com"
        help
            MQTT Broker URL (e.g. mqtt://broker.hivemq.com or mqtt://192.168.1.100:1883).

    config MQTT_TOPIC_LED_SET
        string "MQTT Topic: LED Control Command"
        default "esp32/led/set"
        help
            MQTT topic to subscribe to for controlling LED (payloads: ON, OFF, TOGGLE).

    config MQTT_TOPIC_LED_STATUS
        string "MQTT Topic: LED State Status"
        default "esp32/led/status"
        help
            MQTT topic to publish LED state changes.

    config MQTT_TOPIC_HEARTBEAT
        string "MQTT Topic: Periodic Heartbeat"
        default "esp32/heartbeat"
        help
            MQTT topic for sending periodic telemetry/heartbeat messages.

    config HEARTBEAT_INTERVAL_SEC
        int "Heartbeat Interval (seconds)"
        default 10
        help
            Interval in seconds for sending periodic heartbeat & telemetry status.

endmenu
```

## 02_wifi_mqtt_led/sdkconfig.defaults
```kconfig
CONFIG_ESP_WIFI_SSID="YOUR_WIFI_SSID"
CONFIG_ESP_WIFI_PASSWORD="YOUR_WIFI_PASSWORD"
CONFIG_MQTT_BROKER_URI="mqtt://broker.hivemq.com"
CONFIG_MQTT_TOPIC_LED_SET="esp32/led/set"
CONFIG_MQTT_TOPIC_LED_STATUS="esp32/led/status"
CONFIG_MQTT_TOPIC_HEARTBEAT="esp32/heartbeat"
CONFIG_HEARTBEAT_INTERVAL_SEC=10
```

## 03_wifi_mqtt_4relays/main/Kconfig.projbuild
```kconfig
menu "ESP32 Wi-Fi & 4-Relay MQTT Configuration"

    config ESP_WIFI_SSID
        string "Wi-Fi SSID"
        default "YOUR_WIFI_SSID"
        help
            SSID (network name) of your Wi-Fi router.

    config ESP_WIFI_PASSWORD
        string "Wi-Fi Password"
        default "YOUR_WIFI_PASSWORD"
        help
            Password for your Wi-Fi network.

    config ESP_WIFI_MAXIMUM_RETRY
        int "Maximum Wi-Fi Connection Retries"
        default 10
        help
            Set the Maximum retry count for Wi-Fi connection attempts.

    config MQTT_BROKER_URI
        string "MQTT Broker URI"
        default "mqtt://broker.hivemq.com"
        help
            MQTT Broker URL (e.g. mqtt://broker.hivemq.com or mqtt://192.168.1.100:1883).

    config MQTT_TOPIC_BASE
        string "Base MQTT Topic Prefix"
        default "esp32/relay"
        help
            Base topic prefix. Command topics will be <base>/<1..4>/set and status topics <base>/<1..4>/status.

    config RELAY1_GPIO
        int "Relay 1 GPIO Pin"
        default 18
        help
            GPIO pin number connected to Relay 1.

    config RELAY2_GPIO
        int "Relay 2 GPIO Pin"
        default 19
        help
            GPIO pin number connected to Relay 2.

    config RELAY3_GPIO
        int "Relay 3 GPIO Pin"
        default 22
        help
            GPIO pin number connected to Relay 3.

    config RELAY4_GPIO
        int "Relay 4 GPIO Pin"
        default 23
        help
            GPIO pin number connected to Relay 4.

    config RELAY_ACTIVE_HIGH
        bool "Relays are Active HIGH"
        default n
        help
            Select 'y' if GPIO 1 turns relay ON (Active HIGH). Select 'n' if GPIO 0 turns relay ON (Active LOW).

    config HEARTBEAT_INTERVAL_SEC
        int "Heartbeat Interval (seconds)"
        default 10
        help
            Interval in seconds for sending periodic telemetry & state status of all relays.

endmenu
```

## 03_wifi_mqtt_4relays/sdkconfig.defaults
```kconfig
CONFIG_ESP_WIFI_SSID="YOUR_WIFI_SSID"
CONFIG_ESP_WIFI_PASSWORD="YOUR_WIFI_PASSWORD"
CONFIG_MQTT_BROKER_URI="mqtt://broker.hivemq.com"
CONFIG_RELAY1_GPIO=18
CONFIG_RELAY2_GPIO=19
CONFIG_RELAY3_GPIO=22
CONFIG_RELAY4_GPIO=23
CONFIG_RELAY_ACTIVE_HIGH=n
CONFIG_MQTT_TOPIC_BASE="esp32/relay"
CONFIG_HEARTBEAT_INTERVAL_SEC=10
```
